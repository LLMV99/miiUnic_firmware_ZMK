## boards/shields/miiunici2c/Kconfig.shield
```kconfig
config SHIELD_MIIUNICI2C_LEFT
    def_bool $(shields_list_contains,miiunici2c_left)
  
config SHIELD_MIIUNICI2C_RIGHT
    def_bool $(shields_list_contains,miiunici2c_right)
  
```
